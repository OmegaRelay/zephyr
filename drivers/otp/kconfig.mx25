## drivers/otp/kconfig.mx25
```kconfig
config OTP_MX25
    bool "Micronix MX25 OTP driver"
    default y
    depends on DT_HAS_MICRONIX_MX25_OTP_ENABLED
    depends on SPI_NOR
    help
	  Enable driver for OTP regions inside MX25 SPI-NOR devices

if OTP_MX25

config OTP_INIT_PRIORITY
    default 90

endif # OTP_MX25
```

## dts/bindings/otp/micronix,mx25-otp.yaml
```yaml
title: MX25 OTP

description: |
  Micronix MX25 SPI-NOR OTP (One Time Programmable) controller.

  This binding implementes the OTP driver api for MX25 devices.

compatible: "micronix,mx25-otp"

include: base.yaml

examples:
  - |
    spi {
      spi-nor {
        compatible = "jedec,spi-nor";
        {
          otp {
            compatible = "micronix,mx25-otp";
          };
        };
      };
    };
```

## subsys/rtttl/Kconfig
```kconfig
menuconfig RTTTL
	bool "Ring Tone Text Transfer Language support"
	select BUZZER

if RTTTL

module = RTTTL
module-str = RTTTL Support
module-help = Sets log level for RTTTL support
source "subsys/logging/Kconfig.template.log_config"

endif
```
